## app/boards/our_board/board.yml
```yaml
board:
  name: our_board
  full_name: Custom Board for me 
  vendor: st
  socs:
    - name: stm32f407xx
```

## app/boards/our_board_scratch/board.yml
```yaml
board:
  name: our_board_scratch
  full_name: STM32F407 From Scratch
  vendor: st
  socs:
    - name: stm32f407xx
```
