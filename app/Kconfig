## app/Kconfig
```kconfig
config APP_HEARTBEAT_PERIOD_MS
int "heart beat period in milliseconds"
 default 500 
 range 100 2000

source "Kconfig.zephyr"
```

## app/west.yml
```yaml
manifest:
  version: 0.7

  defaults:
    remote: zephyrproject

  remotes:
    - name: zephyrproject
      url-base: https://github.com/zephyrproject-rtos

  projects:
    - name: zephyr
      repo-path: zephyr
      revision: v4.2.0
      import:
        path-prefix: deps          # <--- THIS is the magic line
        name-allowlist:
          - cmsis_6
          - hal_stm32
          - mcuboot
          - mbedtls

  self:
    path: app
```
